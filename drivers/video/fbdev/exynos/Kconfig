## drivers/video/fbdev/exynos/Kconfig
```kconfig
if SOC_EXYNOS9630 || SOC_EXYNOS9830 || SOC_EXYNOS3830

source "drivers/video/fbdev/exynos/dpu30/Kconfig"

endif # SOC_EXYNOS9630 || SOC_EXYNOS9830 || SOC_EXYNOS3830

if SOC_EXYNOS8895
source "drivers/video/fbdev/exynos/dpu/Kconfig"
source "drivers/video/fbdev/exynos/panel/Kconfig"
endif
```
