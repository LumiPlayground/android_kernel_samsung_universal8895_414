/*
 * SAMSUNG EXYNOS device tree source for reserved-memory
 *
 * Copyright (c) 2015 Samsung Electronics Co., Ltd.
 *		http://www.samsung.com
 *
 * This program is free software; you can redistribute it and/or modify
 * it under the terms of the GNU General Public License version 2 as
 * published by the Free Software Foundation.
 */

#include "exynos8895-rmem.dtsi"

/ {
	reserved-memory {
		#address-cells = <2>;
		#size-cells = <1>;
		ranges;

		camera {
			reg = <0x8 0x80000000 0x15E00000>;
		};

		/* NOTE: reusable region should be aligned by 4MiB */
		video_stream {
			/* TUI : 2560x1440 32bpp 3frames = 2560*1440*(32/8)*3 */
			/* DRM : 0x3800000				      */
			/* 0x3C00000 = ALIGN(max(0x3840000, 0x3800000), 4MiB) */
			reg = <0x0 0xE6C00000 0x3C00000>;
		};
	};
};
